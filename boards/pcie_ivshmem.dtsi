/*
 * Copyright 2023 Linaro.
 *
 * SPDX-License-Identifier: BSD-3-Clause
 */
#include <zephyr/dt-bindings/pcie/pcie.h>

/ {
	ivhsmem {
		ivshmem0: ivshmem {
			compatible = "qemu,ivshmem";

			vendor-id = <0x1af4>;
			device-id = <0x1110>;
			status = "okay";
		};
	};
};
